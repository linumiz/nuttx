## arch/tricore/Kconfig
```kconfig
#
# For a description of the syntax of this configuration file,
# see the file kconfig-language.txt in the NuttX tools repository.
#

if ARCH_TRICORE
comment "Tricore Options"

config TRICORE_TC16
        bool
        default n

config TRICORE_TC18
        bool
        default n

choice
        prompt "AURIX SoC Family"
        default ARCH_CHIP_FAMILY_TC4XX

config ARCH_CHIP_FAMILY_TC3XX
        bool "AURIX Family TC3XX"
        select TRICORE_TC16
        select ARCH_HAVE_TESTSET
        select ARCH_HAVE_IRQTRIGGER
        ---help---
                AURIX TC3XX family: TC3XX

config ARCH_CHIP_FAMILY_TC4XX
        bool "AURIX Family TC4XX"
        select TRICORE_TC18
        select ARCH_HAVE_TESTSET
        select ARCH_HAVE_IRQTRIGGER
        ---help---
                AURIX TC4xx family: TC4XX

endchoice

config ARCH_CHIP
	string
	default "tc3xx"		if ARCH_CHIP_FAMILY_TC3XX
	default "tc4xx"		if ARCH_CHIP_FAMILY_TC4XX

if ARCH_CHIP_FAMILY_TC3XX
source "arch/tricore/src/tc3xx/Kconfig"
endif

if ARCH_CHIP_FAMILY_TC4XX
source "arch/tricore/src/tc4xx/Kconfig"
endif

choice
	prompt "Tricore Toolchain Selection"
	default TRICORE_TOOLCHAIN_LLVM

config TRICORE_TOOLCHAIN_GNUC
	bool "GNU GCC Toolchain"
	---help---
		Use the open-source GNU GCC toolchain for Tricore.
		This requires tricore-elf-gcc to be installed.

config TRICORE_TOOLCHAIN_LLVM
	bool "HighTec LLVM Toolchain"
	---help---
		Use the HighTec closed-source LLVM/Clang toolchain for Tricore.
		This is the commercial toolchain provided by HighTec.

		The toolchain must be installed at:
		/opt/tooling/tricore-llvm/toolchains/tricore/v10.1.0

		Or set LLVM_TOOLCHAIN_PATH in your environment to the installation path.

config TRICORE_TOOLCHAIN_TASKING
	bool "Tasking Toolchain"
	---help---
		Use the Tasking toolchain for Tricore.

endchoice

config TRICORE_LLVM_TOOLCHAIN_PATH
	string "HighTec LLVM Toolchain Path"
	default "/opt/tooling/tricore-llvm/toolchains/tricore/v10.1.0"
	depends on TRICORE_TOOLCHAIN_LLVM
	---help---
		Path to the HighTec LLVM toolchain installation directory.
		The toolchain binaries should be in $(path)/bin/

		Default: /opt/tooling/tricore-llvm/toolchains/tricore/v10.1.0

endif # ARCH_TRICORE
```

## arch/tricore/src/tc3xx/Kconfig
```kconfig
#
# For a description of the syntax of this configuration file,
# see the file kconfig-language.txt in the NuttX tools repository.
#
comment "Infineon Aurix TC3XX Family configurations"

choice
        prompt "Infineon Aurix TC3XX Chip selection"

config TC3XX_CHIP_TC397
        bool "TC397 SoC"
        ---help---
                TC397 SoC

endchoice

config ARCH_TRICORE_CPU_COUNT
	int "TRICORE CPU count"
	default 1
	---help---
		Tricore CPU count

menu "TC3XX Peripheral Support"

# UART
config TRICORE_UART0
        bool "ASCLIN0 UART"
        default n
        select UART0_SERIALDRIVER
        select SERIAL
        ---help---
                Enable the ASCLIN0 peripheral as a UART serial port.

if TRICORE_UART0

config TRICORE_UART0_RXIRQ
        int "ASCLIN0 RX IRQ number"
        default 21

config TRICORE_UART0_TXIRQ
        int "ASCLIN0 TX IRQ number"
        default 20

config TRICORE_UART0_ERIRQ
        int "ASCLIN0 ERR IRQ number"
        default 22

config TRICORE_ASCLINF_FREQUENCY
        int "fASCLINF clock frequency (Hz)"
        default 100000000

endif # TRICORE_UART0

# I2C
menuconfig TC3XX_I2C
        bool "TC3xx I2C Master Driver"
        default n
        depends on I2C
        select ARCH_HAVE_I2CRESET
        ---help---
                Enable I2C master driver for Infineon Aurix TC3xx.

if TC3XX_I2C

config TC3XX_I2C_CLOCK_FREQ
        int "I2C peripheral source clock in Hz"
        default 100000000
        ---help---
                The I2C clock frequency from the CCU. Check your clock
                tree configuration. Default assumes 100 MHz.

config TC3XX_I2C0
        bool "Enable I2C0"
        default n

if TC3XX_I2C0

config TC3XX_I2C0_FREQUENCY
        int "I2C0 default bus frequency"
        default 100000
        ---help---
                Default I2C bus speed in Hz.
                standard mode (100 kHz)
                fast mode (400 kHz)

config TC3XX_I2C0_PISEL
        int "I2C0 pin input select"
        default 1
        range 0 7
        ---help---
                Selects which port pins provide SDA/SCL input signals.

endif # TC3XX_I2C0

config TC3XX_I2C1
        bool "Enable I2C1"
        default n

if TC3XX_I2C1

config TC3XX_I2C1_FREQUENCY
        int "I2C1 default bus frequency"
        default 100000

config TC3XX_I2C1_PISEL
        int "I2C1 pin input select"
        default 0
        range 0 7

endif # TC3XX_I2C1

config TC3XX_I2C2
        bool "Enable I2C2"
        default n

if TC3XX_I2C2

config TC3XX_I2C2_FREQUENCY
        int "I2C2 default bus frequency"
        default 100000

config TC3XX_I2C2_PISEL
        int "I2C2 pin input select"
        default 0
        range 0 7

endif # TC3XX_I2C2

endif # TC3XX_I2C

endmenu
```

## drivers/net/dwxgmac/Kconfig
```kconfig
#
# For a description of the syntax of this configuration file,
# see the file kconfig-language.txt in the NuttX tools repository.
#
menuconfig NET_DWXGMAC
	bool "Synopsys Design Ware XGMAC support"
	default n
	---help---
		Enable designware xgmac Ethernet driver.

if NET_DWXGMAC

config DWXGMAC_NETHERNET
    int "Number of XGMAC Ethernet interfaces"
    default 1

config DWXGMAC_BASE
    hex "XGMAC MAC base address"
    default 0xf9010000

config DWXGMAC_NUM_RX_DMA_DESCRIPTORS
    int "Number of RX DMA descriptors"
    default 8

config DWXGMAC_NUM_TX_DMA_DESCRIPTORS
    int "Number of TX DMA descriptors"
    default 8

config DWXGMAC_DMA_IRQ
    int "XGMAC DMA interrupt number"
    default 0

config NET_DWXGMAC_MDIO
	bool "XGMAC MDIO driver"
	default n
	---help---
		Enable MDIO bus for designware xgmac Ethernet driver.

endif #NET_DWXGMAC
```
