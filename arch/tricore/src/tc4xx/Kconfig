## arch/tricore/src/tc4xx/Kconfig
```kconfig
comment "Infineon Aurix TC4XX Family configurations"

choice
	prompt "Infineon Aurix TC4XX Chip selection"


config TC4XX_CHIP_TC4D7
	bool "TC4D7 SoC"
	---help---
		TC4D7 SoC

endchoice

config ARCH_TRICORE_CPU_COUNT
	int "TRICORE CPU count"
	default 1
	---help---
		Tricore CPU count

menu "TC4XX Peripheral Support"

# UART
config TRICORE_UART0
        bool "ASCLIN0 UART"
        default n
        select UART0_SERIALDRIVER
        select SERIAL
        ---help---
                Enable the ASCLIN0 peripheral as a UART serial port.

if TRICORE_UART0

config TRICORE_UART0_RXIRQ
        int "ASCLIN0 RX IRQ number"
        default 172

config TRICORE_UART0_TXIRQ
        int "ASCLIN0 TX IRQ number"
        default 173

config TRICORE_UART0_ERIRQ
        int "ASCLIN0 ERR IRQ number"
        default 174

config TRICORE_ASCLINF_FREQUENCY
        int "fASCLINF clock frequency (Hz)"
        default 200000000

endif # TRICORE_UART0

# WTU
config TC4X_WDT
	bool "TC4x Watchdog Timer (WTU)"
	default n
	depends on WATCHDOG
	select TC4X_SMU
	---help---
		Enable the TC4x Watchdog Timer driver.  Supports all 7
		WDT instances: CPU0-CPU5 and System WDT.

		WDT overflow triggers an alarm to the SMU.  The SMU must
		be configured (via CONFIG_TC4X_SMU) to issue RESET0_REQ
		for the alarm to cause a system reset.

config TC4X_WDT_FSPB
	int "SPB clock frequency (Hz)"
	default 100000000
	depends on TC4X_WDT
	---help---
		The SPB (System Peripheral Bus) clock frequency in Hz.
		Used to calculate WDT timeout periods.  Default 100 MHz.

# I2C
menuconfig TC4XX_I2C
	bool "TC4xx I2C Master Driver"
	default n
	depends on I2C
	select ARCH_HAVE_I2CRESET
	---help---
		Enable I2C master driver for Infineon Aurix TC4xx.

if TC4XX_I2C

config TC4XX_I2C_CLOCK_FREQ
	int "I2C peripheral source clock (fI2C) in Hz"
	default 100000000
	---help---
		The fI2C clock frequency from the CCU. Check your clock
		tree configuration. Default assumes 100 MHz.

config TC4XX_I2C0
	bool "Enable I2C0"
	default n

if TC4XX_I2C0

config TC4XX_I2C0_FREQUENCY
	int "I2C0 default bus frequency"
	default 100000
	---help---
		Default I2C bus speed in Hz.
		standard mode (100 kHz)
		fast mode (400 kHz)

config TC4XX_I2C0_PISEL
	int "I2C0 pin input select"
	default 1
	range 0 7
	---help---
		Selects which port pins provide SDA/SCL input signals.

endif # TC4XX_I2C0

config TC4XX_I2C1
	bool "Enable I2C1"
	default n

if TC4XX_I2C1

config TC4XX_I2C1_FREQUENCY
	int "I2C1 default bus frequency"
	default 100000

config TC4XX_I2C1_PISEL
	int "I2C1 pin input select"
	default 0
	range 0 7

endif # TC4XX_I2C1

config TC4XX_I2C2
	bool "Enable I2C2"
	default n

if TC4XX_I2C2

config TC4XX_I2C2_FREQUENCY
	int "I2C2 default bus frequency"
	default 100000

config TC4XX_I2C2_PISEL
	int "I2C2 pin input select"
	default 0
	range 0 7

endif # TC4XX_I2C2

endif # TC4XX_I2C

# GETH
menuconfig TC4XX_GETH
	bool "Infineon Tricore GETH support"
	default n
	depends on NET_DWXGMAC
	---help---
		Enable Infineon Tricore GETH support

if TC4XX_GETH

config TRICORE_GETH_BASE
    hex "Tricore GETH base address"
    default 0xf9000000

config TRICORE_GETH_BRIDGE_IRQ
    int "Tricore GETH bridge interrupt number"
    default 760

endif # TC4XX_GETH

endmenu

# SPI
config TC4XX_ASCLIN_SPI
	bool "ASCLIN SPI master support"
	default n
	depends on SPI
	---help---
		Enable SPI master mode on ASCLIN modules.  The ASCLIN IP supports
		UART, LIN, and SPI modes.  This option enables the SPI lower-half
		driver that implements the NuttX spi_ops_s interface.

		Chip select is managed via GPIO, not the hardware ASLSO signal.
		Each bus instance requires its own ASCLIN module (separate from
		any ASCLIN used for UART console).

if TC4XX_ASCLIN_SPI

config TC4XX_ASCLIN2_SPI
	bool "ASCLIN2 as SPI bus 0"
	default y
	---help---
		Use ASCLIN2 for SPI bus 0.  Default pins:
		  MOSI: P15.0 (ATX, ALT02)
		  MISO: P15.1 (ARX, ALTI_A)
		  SCLK: P15.2 (ASCLKO, ALT02)
		  CS:   P14.7 (GPIO)

		Verify pin assignments against your board schematic and
		pinmux.pdf before enabling.

config TC4XX_ASCLIN2_SPI_LOOPBACK
	bool "Enable loopback on ASCLIN2 SPI"
	default y
	depends on TC4XX_ASCLIN2_SPI
	---help---
		Enable internal loopback (IOCR.LB) for ASCLIN2 SPI.  TX is
		internally connected to RX.  Useful for driver validation
		without external wiring.  Disable for real hardware use.

config TC4XX_ASCLIN_SPI_CHARDEV
	bool "Register SPI character device"
	default y
	depends on SPI_DRIVER
	---help---
		Register /dev/spiN character device via spi_register().
		Enables userspace access through standard SPI ioctls.

endif # TC4XX_ASCLIN_SPI
```
